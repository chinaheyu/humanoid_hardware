#include "shell_task.h"
#include "cmsis_os.h"
#include "FreeRTOS_CLI.h"
#include "shell_commands.h"
#include "fatfs.h"
#include "bsp_usart.h"
#include "communicate_task.h"


#define CMD_BUFSIZE 128
#define cmdMAX_INPUT_SIZE CMD_BUFSIZE

/* DEL acts as a backspace. */
#define cmdASCII_DEL		( 0x7F )

// FIFO Buffer
static fifo_s_t shell_fifo;
char* shell_buf;

// 输出缓冲区
char* cOutputBuffer;

// Rx Event
extern osEventFlagsId_t shellReceivedEventHandle;

// 定义欢迎，行首，换行符
static const char * const pcWelcomeMessage = "  _____   _____       ___  ___   _____   _____  \r\n \
/  ___/ |_   _|     /   |/   | |___  | /___  \\ \r\n \
| |___    | |      / /|   /| |    _| |  ___| | \r\n \
\\___  \\   | |     / / |__/ | |   |_  { /  ___/ \r\n \
 ___| |   | |    / /       | |  ___| | | |___  \r\n \
/_____/   |_|   /_/        |_| |_____/ |_____| \r\n \
\r\nWelcome to alientek stm32f407 command server.\r\nType 'help' to view a list of registered commands.\r\n";
static const char * const pcEndOfOutputMessage = "stm32>> ";
static const char * const pcNewLine = "\r\n";

// Variables for command processing.
static signed char cRxedChar;
static uint8_t ucInputIndex = 0;
static char *pcOutputString;
static char *cInputString;
static char *cLastInputString;
static BaseType_t xReturned;

// usart1 dma received callback.
uint32_t shell_rx_callback(uint8_t *buff, uint16_t len)
{
    len = fifo_s_puts(&shell_fifo, (char *)buff, len);
    osEventFlagsSet(shellReceivedEventHandle, 0x00000001U);
    return len;
}

extern void vRegisterSampleCLICommands( void );
extern void vRegisterFileSystemCLICommands( void );

void cli_cmd_init(void)
{
    // 如果有SD卡，挂载并加载文件相关命令
    retSD = f_mount(&SDFatFS, SDPath, 1);
    if(retSD == FR_OK)
    {
        vRegisterFileSystemCLICommands();
        cli_send_str("Detected external storage device, automatic mounting successful.\r\n");
    }
    
    vRegisterSampleCLICommands();
    register_shell_commands();
}

/* 终端命令解析处理 */
void cli_process(char *str_buf, int str_len)
{
    int str_idx = 0;

    while (str_idx < str_len)
    {
        cRxedChar = str_buf[str_idx];
        str_idx ++;

        /* Was it the end of the line? */
        if( cRxedChar == '\n' || cRxedChar == '\r' )
        {
            if(ucInputIndex > 0)
            {
                /* Just to space the output from the input. */
                cli_send_nbytes(pcNewLine, strlen(pcNewLine));
                
                /* Pass the received command to the command interpreter.  The
                command interpreter is called repeatedly until it returns
                pdFALSE	(indicating there is no more output) as it might
                generate more than one string. */
                do
                {
                    /* Get the next output string from the command interpreter. */
                    xReturned = FreeRTOS_CLIProcessCommand( cInputString, pcOutputString, configCOMMAND_INT_MAX_OUTPUT_SIZE );

                    /* Write the generated string to the UART. */
                    cli_send_nbytes(pcOutputString, strlen(pcOutputString));

                } while( xReturned != pdFALSE );
                
                cli_send_nbytes(pcEndOfOutputMessage, strlen( pcEndOfOutputMessage));
            }

            /* All the strings generated by the input command have been
            sent.  Clear the input string ready to receive the next command.
            Remember the command that was just processed first in case it is
            to be processed again. */
            strcpy( cLastInputString, cInputString );
            ucInputIndex = 0;
            memset( cInputString, 0x00, cmdMAX_INPUT_SIZE );
        }
        else
        {
            if( ( cRxedChar == '\b' ) || ( cRxedChar == cmdASCII_DEL ) )
            {
                /* Backspace was pressed.  Erase the last character in the
                string - if any. */
                if( ucInputIndex > 0 )
                {
                    ucInputIndex--;
                    cInputString[ ucInputIndex ] = '\0';
                    
                    /* Echo the character back. */
                    cli_send_nbytes("\b", 1);
                }
            }
            else
            {
                /* A character was entered.  Add it to the string entered so
                far.  When a \n is entered the complete	string will be
                passed to the command interpreter. */
                if( ( cRxedChar >= ' ' ) && ( cRxedChar <= '~' ) )
                {
                    if( ucInputIndex < cmdMAX_INPUT_SIZE )
                    {
                        cInputString[ ucInputIndex ] = cRxedChar;
                        ucInputIndex++;
                        
                        /* Echo the character back. */
                        cli_send_nbytes((char*)&cRxedChar, sizeof(cRxedChar));
                    }
                }
            }
        }
    }
}

// 命令行输出函数
void cli_send_nbytes(const char *out_str, uint32_t len)
{
    usart1_transmit((uint8_t *)out_str, len);
    int send_size;
    while(len > 0){
        send_size = send_cmd_with_data(CMD_CONSOLE_OUTPUT, (uint8_t*)out_str, len);
        len -= send_size;
        out_str += send_size;
    }
}

void print_welcome(void)
{
    pcOutputString = FreeRTOS_CLIGetOutputBuffer();
    sprintf(pcOutputString, "\r\nAlientek stm32f407 hardware: \r\nbuild time: %s-%s\r\n\r\n%s\r\n", __DATE__, __TIME__, pcWelcomeMessage);
    cli_send_str(pcOutputString);
    cli_send_str(pcEndOfOutputMessage);
}

void shell_task(void *argument)
{
    UNUSED(argument);
    
    // 分配输出缓冲内存
    cOutputBuffer = pvPortMalloc(configCOMMAND_INT_MAX_OUTPUT_SIZE);
    shell_buf = pvPortMalloc(CMD_BUFSIZE);
    cInputString = pvPortMalloc(cmdMAX_INPUT_SIZE);
    cLastInputString = pvPortMalloc(cmdMAX_INPUT_SIZE);
    
    // 初始化fifo
    fifo_s_init(&shell_fifo, shell_buf, CMD_BUFSIZE);
    
    // 注册回调函数
    usart1_rx_callback_register(shell_rx_callback);

    // 注册控制台命令
    cli_cmd_init();
    
    // 等待一段时间后打印欢迎
    osDelay(100);
    print_welcome();
    
    char input_buf[CMD_BUFSIZE];
    int ret;
    while (1)
    {
        osEventFlagsWait(shellReceivedEventHandle, 0x00000001U, osFlagsWaitAny, 1000);
        uint16_t used_len;
        used_len = shell_fifo.used_num;
        ret = fifo_s_gets(&shell_fifo, input_buf, used_len);
        if (ret > 0)
        {
            cli_process(input_buf, ret);
        }
    }
}

